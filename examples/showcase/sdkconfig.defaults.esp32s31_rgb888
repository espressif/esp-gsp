## examples/usage/custom_draw/sdkconfig.defaults.esp32p4
```kconfig
CONFIG_EXAMPLE_LCD_INTERFACE_MIPI_DSI=y
CONFIG_SPIRAM=y
CONFIG_SPIRAM_MODE_HEX=y
CONFIG_SPIRAM_SPEED_200M=y
CONFIG_CACHE_L2_CACHE_256KB=y
CONFIG_CACHE_L2_CACHE_LINE_128B=y
```

## examples/usage/custom_draw/sdkconfig.defaults.esp32s3_spi
```kconfig
CONFIG_EXAMPLE_LCD_INTERFACE_SPI_WITH_PSRAM=y
CONFIG_SPIRAM=y
CONFIG_SPIRAM_MODE_OCT=y
CONFIG_SPIRAM_SPEED_80M=y
CONFIG_ESP_DEFAULT_CPU_FREQ_MHZ_240=y
```

## examples/usage/effects/sdkconfig.defaults
```kconfig
CONFIG_COMPILER_CXX_EXCEPTIONS=n
CONFIG_ESP_MAIN_TASK_STACK_SIZE=20480
CONFIG_ESP_TASK_WDT_INIT=n
CONFIG_ESPTOOLPY_FLASHSIZE_4MB=y
CONFIG_PARTITION_TABLE_CUSTOM=y
CONFIG_PARTITION_TABLE_CUSTOM_FILENAME="partitions.csv"

CONFIG_COMPILER_OPTIMIZATION_PERF=y
CONFIG_FREERTOS_HZ=1000
```

## examples/usage/effects/sdkconfig.defaults.esp32s31
```kconfig
CONFIG_SPIRAM=y
CONFIG_SPIRAM_SPEED_250M=y

CONFIG_EXAMPLE_LCD_INTERFACE_RGB=y
CONFIG_EXAMPLE_DISPLAY_ROTATION_270=y
```

## examples/usage/hello_world/components/hw_init/Kconfig.projbuild
```kconfig
menu "Example HW Init"

    choice EXAMPLE_LCD_INTERFACE
        prompt "Example board/display profile"
        depends on IDF_TARGET_ESP32P4 || IDF_TARGET_ESP32S31 || \
                   IDF_TARGET_ESP32S3 || IDF_TARGET_ESP32C3
        default EXAMPLE_LCD_INTERFACE_MIPI_DSI if IDF_TARGET_ESP32P4
        default EXAMPLE_LCD_INTERFACE_RGB if IDF_TARGET_ESP32S31
        default EXAMPLE_LCD_INTERFACE_SPI_WITHOUT_PSRAM if IDF_TARGET_ESP32C3
        default EXAMPLE_LCD_INTERFACE_QSPI if IDF_TARGET_ESP32S3

        config EXAMPLE_LCD_INTERFACE_MIPI_DSI
            bool "ESP32-P4: EK79007 MIPI-DSI 1024x600 + GT911"
            depends on IDF_TARGET_ESP32P4

        config EXAMPLE_LCD_INTERFACE_RGB
            bool "ESP32-S31/S3: 16-bit RGB 800x480 + GT1151 (S3 LCD-EV SUB3)"
            depends on IDF_TARGET_ESP32S31 || IDF_TARGET_ESP32S3

        config EXAMPLE_LCD_INTERFACE_RGB24
            bool "ESP32-S31: 24-bit RGB 800x480, no touch"
            depends on IDF_TARGET_ESP32S31

        config EXAMPLE_LCD_INTERFACE_QSPI
            bool "ESP32-S3: ST77916 QSPI 360x360 with TE"
            depends on IDF_TARGET_ESP32S3

        config EXAMPLE_LCD_INTERFACE_QSPI_CO5300
            bool "ESP32-S31: CO5300 QSPI 480x480 with TE + CST9217"
            depends on IDF_TARGET_ESP32S31

        config EXAMPLE_LCD_INTERFACE_SPI_WITH_PSRAM
            bool "ESP32-S3: ILI9341 SPI 320x240 + GT911"
            depends on IDF_TARGET_ESP32S3

        config EXAMPLE_LCD_INTERFACE_SPI_WITHOUT_PSRAM
            bool "ESP32-C3: GC9A01 SPI 240x240 knob board"
            depends on IDF_TARGET_ESP32C3
    endchoice

    config EXAMPLE_LCD_FRAME_BUFFERS
        int "Native LCD frame buffers"
        depends on EXAMPLE_LCD_INTERFACE_MIPI_DSI || EXAMPLE_LCD_INTERFACE_RGB || EXAMPLE_LCD_INTERFACE_RGB24
        range 2 3
        default 3
        help
            Number of native frame buffers allocated by the example RGB/DSI
            panel driver. Three preserves the existing AUTO presenter profile.
            Two selects DOUBLE_PARTIAL in the presenter as well as allocating
            two driver buffers; changing only the driver count is insufficient.

            Two saves one width * height * native-color-bytes buffer in PSRAM,
            but can increase frame-buffer waits and tail latency. Keep three
            when queue slack is more important than RAM. Validate panel output
            under the application's workload before choosing two. This option
            does not change SPI/QSPI panels with their own display GRAM.

    choice EXAMPLE_DISPLAY_ROTATION
        prompt "Display rotation"
        default EXAMPLE_DISPLAY_ROTATION_0
        help
            Panel-level rotation: the scene renders in its logical
            orientation and rotates into the panel at present time.
            90/270 need a scene whose resolution matches the
            transposed panel (square panels work with any angle; the
            RGB benchmark ships a portrait 480x800 bundle).

        config EXAMPLE_DISPLAY_ROTATION_0
            bool "0"
        config EXAMPLE_DISPLAY_ROTATION_90
            bool "90"
        config EXAMPLE_DISPLAY_ROTATION_180
            bool "180"
        config EXAMPLE_DISPLAY_ROTATION_270
            bool "270"
    endchoice

endmenu
```

## examples/usage/hello_world/sdkconfig.defaults.esp32s31_rgb888
```kconfig
# ESP32-S31: 800x480 24-bit RGB panel.
CONFIG_EXAMPLE_LCD_INTERFACE_RGB24=y
CONFIG_SPIRAM=y
CONFIG_SPIRAM_SPEED_250M=y
```
