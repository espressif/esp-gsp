## examples/performance/benchmark/boards/hw_init/Kconfig.projbuild
```kconfig
menu "Benchmark local board"

    config EXAMPLE_LCD_FRAME_BUFFERS
        int "GC9503 native LCD frame buffers"
        depends on IDF_TARGET_ESP32S31
        range 2 3
        default 2
        help
            Two framebuffers select the presenter's DOUBLE_PARTIAL contract.
            Three uses AUTO and costs one
            additional 480 * 480 * 2-byte PSRAM framebuffer.

endmenu
```

## examples/performance/benchmark/sdkconfig.defaults
```kconfig
CONFIG_COMPILER_OPTIMIZATION_PERF=y
CONFIG_FREERTOS_HZ=1000
CONFIG_FREERTOS_GENERATE_RUN_TIME_STATS=y
CONFIG_FREERTOS_RUN_TIME_COUNTER_TYPE_U64=y
CONFIG_FREERTOS_RUN_TIME_STATS_USING_ESP_TIMER=y
CONFIG_COMPILER_CXX_EXCEPTIONS=n
CONFIG_ESP_MAIN_TASK_STACK_SIZE=20480
CONFIG_ESP_TASK_WDT_INIT=n
CONFIG_ESPTOOLPY_FLASHSIZE_4MB=y
CONFIG_PARTITION_TABLE_CUSTOM=y
CONFIG_PARTITION_TABLE_CUSTOM_FILENAME="partitions_benchmark.csv"
CONFIG_ESP_GSP_MAX_LISTS=8
```
