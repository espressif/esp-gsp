## examples/benchmark/components/hw_init/Kconfig.projbuild
```kconfig
menu "Example HW Init"

    choice EXAMPLE_LCD_INTERFACE
        prompt "Example board/display profile"
        depends on IDF_TARGET_ESP32P4 || IDF_TARGET_ESP32S31 || \
                   IDF_TARGET_ESP32S3 || IDF_TARGET_ESP32C3
        default EXAMPLE_LCD_INTERFACE_MIPI_DSI if IDF_TARGET_ESP32P4
        default EXAMPLE_LCD_INTERFACE_RGB if IDF_TARGET_ESP32S31
        default EXAMPLE_LCD_INTERFACE_SPI_WITHOUT_PSRAM if IDF_TARGET_ESP32C3
        default EXAMPLE_LCD_INTERFACE_QSPI if IDF_TARGET_ESP32S3

        config EXAMPLE_LCD_INTERFACE_MIPI_DSI
            bool "ESP32-P4: EK79007 MIPI-DSI 1024x600 + GT911"
            depends on IDF_TARGET_ESP32P4

        config EXAMPLE_LCD_INTERFACE_RGB
            bool "ESP32-S31/S3: 16-bit RGB 800x480 + GT1151"
            depends on IDF_TARGET_ESP32S31 || IDF_TARGET_ESP32S3

        config EXAMPLE_LCD_INTERFACE_RGB24
            bool "ESP32-S31: 24-bit RGB 800x480, no touch"
            depends on IDF_TARGET_ESP32S31

        config EXAMPLE_LCD_INTERFACE_QSPI
            bool "ESP32-S3: ST77916 QSPI 360x360 with TE"
            depends on IDF_TARGET_ESP32S3

        config EXAMPLE_LCD_INTERFACE_QSPI_CO5300
            bool "ESP32-S31: CO5300 QSPI 480x480 with TE + CST9217"
            depends on IDF_TARGET_ESP32S31

        config EXAMPLE_LCD_INTERFACE_SPI_WITH_PSRAM
            bool "ESP32-S3: ILI9341 SPI 320x240 + GT911"
            depends on IDF_TARGET_ESP32S3

        config EXAMPLE_LCD_INTERFACE_SPI_WITHOUT_PSRAM
            bool "ESP32-C3: GC9A01 SPI 240x240 knob board"
            depends on IDF_TARGET_ESP32C3
    endchoice

    choice EXAMPLE_DISPLAY_ROTATION
        prompt "Display rotation"
        default EXAMPLE_DISPLAY_ROTATION_0
        help
            Panel-level rotation: the scene renders in its logical
            orientation and rotates into the panel at present time.
            90/270 need a scene whose resolution matches the
            transposed panel (square panels work with any angle; the
            RGB benchmark ships a portrait 480x800 bundle).

        config EXAMPLE_DISPLAY_ROTATION_0
            bool "0"
        config EXAMPLE_DISPLAY_ROTATION_90
            bool "90"
        config EXAMPLE_DISPLAY_ROTATION_180
            bool "180"
        config EXAMPLE_DISPLAY_ROTATION_270
            bool "270"
    endchoice

endmenu
```

## examples/benchmark/sdkconfig.defaults
```kconfig
CONFIG_COMPILER_OPTIMIZATION_PERF=y
CONFIG_FREERTOS_HZ=1000
CONFIG_COMPILER_CXX_EXCEPTIONS=n
CONFIG_ESP_MAIN_TASK_STACK_SIZE=20480
CONFIG_ESP_TASK_WDT_INIT=n
CONFIG_ESPTOOLPY_FLASHSIZE_4MB=y
CONFIG_PARTITION_TABLE_CUSTOM=y
CONFIG_PARTITION_TABLE_CUSTOM_FILENAME="partitions_benchmark.csv"
CONFIG_ESP_GSP_MAX_LISTS=8
```

## examples/benchmark/sdkconfig.defaults.esp32c3
```kconfig
# ESP32-C3: SPI panel, no PSRAM
CONFIG_EXAMPLE_LCD_INTERFACE_SPI_WITHOUT_PSRAM=y
```

## examples/external_assets/main/Kconfig.projbuild
```kconfig
menu "External asset example"
config GSP_ASSET_MOUNT_PATH
    string "Mounted filesystem path"
    default "/sdcard"
config GSP_ASSET_USE_EXISTING_MOUNT
    bool "Use a filesystem mounted by the application/BSP"
    default n
    help
        Use for NAND or a BSP-managed SDMMC card. Mount it before app_main
        opens media.gspb. The generic example otherwise mounts an SDSPI card.
config GSP_ASSET_SD_SPI3
    bool "Use SPI3 for SD (avoid the LCD SPI bus)"
    depends on !GSP_ASSET_USE_EXISTING_MOUNT && SOC_SPI_PERIPH_NUM > 2
    default y
config GSP_ASSET_SD_MOSI
    int "SD MOSI GPIO (-1 = not configured)"
    depends on !GSP_ASSET_USE_EXISTING_MOUNT
    range -1 99
    default -1
config GSP_ASSET_SD_MISO
    int "SD MISO GPIO (-1 = not configured)"
    depends on !GSP_ASSET_USE_EXISTING_MOUNT
    range -1 99
    default -1
config GSP_ASSET_SD_CLK
    int "SD CLK GPIO (-1 = not configured)"
    depends on !GSP_ASSET_USE_EXISTING_MOUNT
    range -1 99
    default -1
config GSP_ASSET_SD_CS
    int "SD CS GPIO (-1 = not configured)"
    depends on !GSP_ASSET_USE_EXISTING_MOUNT
    range -1 99
    default -1
endmenu
```

## examples/external_assets/sdkconfig.defaults
```kconfig
CONFIG_ESP_MAIN_TASK_STACK_SIZE=20480
CONFIG_ESPTOOLPY_FLASHSIZE_4MB=y
CONFIG_PARTITION_TABLE_SINGLE_APP_LARGE=y
```

## examples/performance/benchmark/sdkconfig.defaults.esp32p4
```kconfig
# ESP32-P4: MIPI-DSI, hex PSRAM + XIP + L2 cache
CONFIG_EXAMPLE_LCD_INTERFACE_MIPI_DSI=y
CONFIG_SPIRAM=y
CONFIG_SPIRAM_MODE_HEX=y
CONFIG_SPIRAM_SPEED_200M=y
CONFIG_SPIRAM_XIP_FROM_PSRAM=y
CONFIG_SPIRAM_MEMTEST=n
CONFIG_CACHE_L2_CACHE_256KB=y
CONFIG_CACHE_L2_CACHE_LINE_128B=y
CONFIG_IDF_EXPERIMENTAL_FEATURES=y
CONFIG_PARTITION_TABLE_OFFSET=0x10000
```

## examples/scenarios/smartwatch/sdkconfig.defaults
```kconfig
CONFIG_COMPILER_CXX_EXCEPTIONS=n
CONFIG_ESP_MAIN_TASK_STACK_SIZE=20480
CONFIG_ESP_TASK_WDT_INIT=n
CONFIG_ESPTOOLPY_FLASHSIZE_4MB=y
CONFIG_PARTITION_TABLE_SINGLE_APP_LARGE=y
```

## examples/scenarios/thermostat/main/Kconfig.projbuild
```kconfig
menu "Thermostat encoder"
config THERMOSTAT_ENCODER_A
    int "Encoder A GPIO"
    default 10
    range 0 21
config THERMOSTAT_ENCODER_B
    int "Encoder B GPIO"
    default 6
    range 0 21
config THERMOSTAT_ENCODER_PRESS
    int "Active-low push button GPIO"
    default 9
    range 0 21
config THERMOSTAT_ENCODER_REVERSE
    bool "Reverse rotation direction"
    default n
endmenu
```

## examples/scenarios/thermostat/sdkconfig.defaults
```kconfig
CONFIG_COMPILER_CXX_EXCEPTIONS=n
CONFIG_ESP_MAIN_TASK_STACK_SIZE=12288
CONFIG_ESPTOOLPY_FLASHSIZE_4MB=y
CONFIG_PARTITION_TABLE_SINGLE_APP_LARGE=y
CONFIG_FREERTOS_HZ=1000
CONFIG_EXAMPLE_LCD_INTERFACE_SPI_WITHOUT_PSRAM=y
CONFIG_EXAMPLE_DISPLAY_ROTATION_0=y
```

## examples/scenarios/washing_machine/sdkconfig.defaults
```kconfig
CONFIG_COMPILER_CXX_EXCEPTIONS=n
CONFIG_ESP_MAIN_TASK_STACK_SIZE=12288
CONFIG_ESPTOOLPY_FLASHSIZE_4MB=y
CONFIG_PARTITION_TABLE_SINGLE_APP_LARGE=y
CONFIG_SPIRAM=y
CONFIG_SPIRAM_MODE_OCT=y
CONFIG_SPIRAM_SPEED_80M=y
CONFIG_ESP_DEFAULT_CPU_FREQ_MHZ_240=y
CONFIG_EXAMPLE_LCD_INTERFACE_SPI_WITH_PSRAM=y
CONFIG_EXAMPLE_DISPLAY_ROTATION_0=y
```

## examples/showcase/sdkconfig.defaults
```kconfig
CONFIG_COMPILER_OPTIMIZATION_PERF=y
CONFIG_ESP_MAIN_TASK_STACK_SIZE=6144
CONFIG_ESP_SYSTEM_EVENT_TASK_STACK_SIZE=4096
CONFIG_ESPTOOLPY_FLASHSIZE_16MB=y
CONFIG_PARTITION_TABLE_CUSTOM=y
CONFIG_PARTITION_TABLE_CUSTOM_FILENAME="partitions_showcase.csv"
CONFIG_PARTITION_TABLE_FILENAME="partitions_showcase.csv"
CONFIG_ESP_GSP_CONTEXT_DEFAULT_INSTANCES=32
```

## examples/showcase/sdkconfig.defaults.esp32p4
```kconfig
# ESP32-P4: 1024x600 MIPI-DSI display with PSRAM.
CONFIG_EXAMPLE_LCD_INTERFACE_MIPI_DSI=y
CONFIG_SPIRAM=y
CONFIG_SPIRAM_MODE_HEX=y
CONFIG_SPIRAM_SPEED_200M=y
CONFIG_SPIRAM_XIP_FROM_PSRAM=y
CONFIG_SPIRAM_MEMTEST=n
CONFIG_CACHE_L2_CACHE_256KB=y
CONFIG_CACHE_L2_CACHE_LINE_128B=y
CONFIG_IDF_EXPERIMENTAL_FEATURES=y
CONFIG_PARTITION_TABLE_OFFSET=0x10000
```
